#include <Arduino.h>
#include <string.h>
#include <ESP8266WiFi.h>
#include <FirebaseClient.h>
#include <WiFiClientSecure.h>
#include <NTPClient.h>
#include <WiFiUdp.h>

#define WIFI_SSID "eclipse"
#define WIFI_PASSWORD "helloworld"
#define DATABASE_SECRET "" // DATABASE SECRET
#define DATABASE_URL "ew-project-iiith-default-rtdb.firebaseio.com/" // DATABASE URL



const int pins[] = {13,12,14,2,0,4,5,16};//define LED pins
int rows = 8;//number of rows
const int charHeight = 8;
const int charWidth = 5;
WiFiUDP ntpUDP;
NTPClient timeClient(ntpUDP, "pool.ntp.org");
String months[12]={"Jan", "Feb", "Mar", "Apr", "May", "Jun", "Jul", "Aug", "Sept", "Oct", "Nov", "Dec"};
const unsigned char font[95][5] = {//font array
  {0x00, 0x00, 0x00, 0x00, 0x00}, //   0x20 32
  {0x00, 0x00, 0x6f, 0x00, 0x00}, // ! 0x21 33
  {0x00, 0x07, 0x00, 0x07, 0x00}, // " 0x22 34
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  {0x04, 0x02, 0x04, 0x08, 0x04}, // ~ 0x7e 126
}; 

char textString[] = "WordToShow";
WiFiClientSecure ssl1, ssl2;

DefaultNetwork network;
AsyncClientClass client1(ssl1, getNetwork(network)), client2(ssl2, getNetwork(network));
FirebaseApp app;
RealtimeDatabase Database;
AsyncResult result1, result2;
NoAuth noAuth;

int clk = 4;

void printResult(AsyncResult &aResult) {

  if (aResult.isDebug()) {
    Firebase.printf("Debug task: %s, msg: %s\n", aResult.uid().c_str(), aResult.debug().c_str());
  }

  if (aResult.isError()) {
    Firebase.printf("Error task: %s, msg: %s, code: %d\n", aResult.uid().c_str(), aResult.error().message().c_str(), aResult.error().code());
  }

  if (aResult.available()) {
    RealtimeDatabaseResult &RTDB = aResult.to<RealtimeDatabaseResult>();
    if (RTDB.isStream()) {
      Serial.println("----------------------------");
      Firebase.printf("task: %s\n", aResult.uid().c_str());
      Firebase.printf("event: %s\n", RTDB.event().c_str());
      Firebase.printf("path: %s\n", RTDB.dataPath().c_str());
      Firebase.printf("data: %s\n", RTDB.to<const char *>());
      Firebase.printf("type: %d\n", RTDB.type());
      bool v1 = RTDB.to<bool>();
      if(RTDB.type() == 1){
        strcpy(textString, "");
        int v2 = RTDB.to<int>();
        if (v2 != 0) {
          clk = v2;
        }
      }
      float v3 = RTDB.to<float>();
      double v4 = RTDB.to<double>();
      if(RTDB.type() == 5){
        clk = 4;
        String v5 = RTDB.to<String>();
        strcpy(textString, v5.c_str());
      }
    } else {
      Serial.println("----------------------------");
      Firebase.printf("task: %s, payload: %s\n", aResult.uid().c_str(), aResult.c_str());
    }
  }
}

void setup() {

  Serial.begin(115200);
  WiFi.begin(WIFI_SSID, WIFI_PASSWORD);

  for (int i = 0; i < rows; i++) {
    pinMode(pins[i], OUTPUT); // Set all pins as output
  }

  // Power pins (if needed for your circuit)
  pinMode(D8, OUTPUT);
  pinMode(D9, OUTPUT);
  digitalWrite(D8, HIGH);
  digitalWrite(D9, HIGH);

  Serial.print("Connecting to Wi-Fi");
  while (WiFi.status() != WL_CONNECTED) {
    Serial.print(".");
    delay(300);
  }
  Serial.println();
  Serial.print("Connected with IP: ");
  Serial.println(WiFi.localIP());
  Serial.println();

  Firebase.printf("Firebase Client v%s\n", FIREBASE_CLIENT_VERSION);
  timeClient.begin();
  timeClient.setTimeOffset(19800);
  ssl1.setInsecure();
  ssl2.setInsecure();
#if defined(ESP8266)
  ssl1.setBufferSizes(1024, 1024);
  ssl2.setBufferSizes(1024, 1024);
#endif
  initializeApp(client1, app, getAuth(noAuth));
  app.getApp<RealtimeDatabase>(Database);
  Database.url(DATABASE_URL);
  Database.get(client1, "/test/data", result1, true);
}

void loop() {
  timeClient.update();
  Database.loop();
  printResult(result1);
  if (clk == 1 && !strcmp(textString,"")) {
    Serial.println("Clock 1");
    int currentHour = timeClient.getHours();
    int currentMinute = timeClient.getMinutes();
    String formattedTime = String(currentHour) + ":" + String(currentMinute);
    Serial.println(formattedTime);
    for (int k = sizeof(formattedTime) - 1; k > -1; k--) {
      Display(formattedTime[k]);
    }
  } else if (clk == 2 && !strcmp(textString,"")) {
    Firebase.printf("Clock 2\n");
    time_t epochTime = timeClient.getEpochTime();
    struct tm *ptm = gmtime ((time_t *)&epochTime); 
    int monthDay = ptm->tm_mday;
    int currentMonth = ptm->tm_mon+1;
    int currentYear = ptm->tm_year+1900;
    String formattedDate = String(monthDay) + "-" + String(currentMonth) + "-" + String(currentYear);
    Serial.println(formattedDate);
    for (int k = sizeof(formattedDate) - 1; k > -1; k--) {
      Display(formattedDate[k]);
    }
  } else if (clk == 3 && !strcmp(textString,"")) {
    Firebase.printf("Clock 3\n");
    time_t epochTime = timeClient.getEpochTime();
    struct tm *ptm = gmtime ((time_t *)&epochTime); 
    int monthDay = ptm->tm_mday;
    int currentMonth = ptm->tm_mon+1;
    int currentYear = ptm->tm_year+1900;
    String currentMonthName = months[currentMonth-1];
    String formattedDate = String(monthDay) + "-" + String(currentMonthName) + "-" + String(currentYear);
    Serial.println(formattedDate);
    for (int k = sizeof(formattedDate) - 1; k > -1; k--) {
      Display(formattedDate[k]);
    }
  } else {
    for (int k = sizeof(textString) - 1; k > -1; k--) {
      Display(textString[k]);
    }
  }
}

void Display(char ch) {
  if (ch < 32 || ch > 126) {
    ch = 32; // Default to space for unsupported characters
  }
  ch -= 32;

  for (int i = charWidth - 1; i > -1; i--) {
    byte b = font[ch][i];
    for (int j = 0; j < charHeight; j++) {
      digitalWrite(pins[j], bitRead(b, j)); // Set each row of LEDs
    }
    delay(1); // Delay for persistence of vision effect
  }

  for (int i = 0; i < rows; i++) {
    digitalWrite(pins[i], LOW); // Turn off all rows
  }
  delay(1); // Delay between characters
}


